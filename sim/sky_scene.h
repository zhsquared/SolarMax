#pragma once
// SolarMax - shared 3D "sky dome" geometry for the simulators.
//
// This is the one place both viewers get their geometry from:
//   * sim/main_tui.cpp      (terminal wireframe dome, FTXUI)
//   * sim3d/main_3d.cpp     (real 3D window, raylib)
//
// It is deliberately renderer-agnostic: everything is returned in
// East-North-Up (ENU) coordinates and each viewer maps ENU onto its own axes.
// Crucially, the sun-path arcs are generated by calling the REAL firmware math
// (calculateSolarPositionRaw), so what you see on the dome is exactly what the
// controller computes - that is the whole point of the demo.

#include "solar_position.h"
#include "tracker_core.h"
#include <vector>
#include <cmath>

// A vector in East-North-Up. (e)ast, (n)orth, (u)p - all in the same units.
// As a direction it is a point on/inside the unit sky dome; scale by a radius
// to place it in a scene.
struct V3 { float e, n, u; };

// ── tiny vector helpers ──────────────────────────────────────────────────────
inline V3    v3add(V3 a, V3 b)        { return { a.e+b.e, a.n+b.n, a.u+b.u }; }
inline V3    v3sub(V3 a, V3 b)        { return { a.e-b.e, a.n-b.n, a.u-b.u }; }
inline V3    v3scale(V3 a, float s)   { return { a.e*s, a.n*s, a.u*s }; }
inline float v3dot(V3 a, V3 b)        { return a.e*b.e + a.n*b.n + a.u*b.u; }
inline V3    v3cross(V3 a, V3 b)      { return { a.n*b.u - a.u*b.n,
                                                 a.u*b.e - a.e*b.u,
                                                 a.e*b.n - a.n*b.e }; }
inline float v3len(V3 a)              { return std::sqrt(v3dot(a, a)); }
inline V3    v3norm(V3 a)             { float L = v3len(a); return L < 1e-9f ? a : v3scale(a, 1.0f/L); }

static inline double SKY_D2R(double d) { return d * M_PI / 180.0; }

// Unit direction toward a point in the sky given elevation (deg above horizon)
// and azimuth (deg from north, clockwise). Matches the ENU convention used in
// solar_position.cpp exactly (E=cos·sin, N=cos·cos, U=sin).
inline V3 skyDir(double elevDeg, double azDeg) {
    double el = SKY_D2R(elevDeg), az = SKY_D2R(azDeg);
    return { (float)(std::cos(el)*std::sin(az)),
             (float)(std::cos(el)*std::cos(az)),
             (float)(std::sin(el)) };
}

// Unit direction along the rotation axis, from its tilt (deg above horizontal)
// and azimuth (deg from north the raised end faces). Flat N-S axis => (0,1,0).
inline V3 axisDir(double tiltDeg, double azDeg) {
    double bt = SKY_D2R(tiltDeg), ga = SKY_D2R(azDeg);
    return { (float)(std::cos(bt)*std::sin(ga)),
             (float)(std::cos(bt)*std::cos(ga)),
             (float)(std::sin(bt)) };
}

// The "panel faces straight up" reference direction n0: Up with its along-axis
// part removed (same construction as panelAngleForAxis in solar_position.cpp).
inline V3 panelUpRef(V3 axis) {
    V3 up{0,0,1};
    V3 n0 = v3sub(up, v3scale(axis, v3dot(up, axis)));
    return v3norm(n0);
}

// Unit normal of the panel face when rotated by panelAngleDeg about the axis.
// Reconstructs the exact n0 / w basis the tracking math uses, so "normal points
// at the sun" is geometrically identical to the controller's decision.
//   normal(r) = cos(r)·n0 + sin(r)·w,   w = n0 × axis   (w points toward +west)
inline V3 panelNormal(double panelAngleDeg, double axisTiltDeg, double axisAzimuthDeg) {
    V3 axis = axisDir(axisTiltDeg, axisAzimuthDeg);
    V3 n0   = panelUpRef(axis);
    V3 w    = v3cross(n0, axis);
    double r = SKY_D2R(panelAngleDeg);
    return v3norm(v3add(v3scale(n0, (float)std::cos(r)), v3scale(w, (float)std::sin(r))));
}

// Four corners of the panel plate (for drawing it as a rectangle), centered at
// the origin. Long side runs along the rotation axis; short side is normal×axis.
inline void panelQuad(double panelAngleDeg, double axisTiltDeg, double axisAzimuthDeg,
                      float halfLen, float halfWid, V3 out[4]) {
    V3 axis = v3norm(axisDir(axisTiltDeg, axisAzimuthDeg));
    V3 nrm  = panelNormal(panelAngleDeg, axisTiltDeg, axisAzimuthDeg);
    V3 side = v3norm(v3cross(nrm, axis));           // in-plane, across the axis
    V3 a = v3scale(axis, halfLen), s = v3scale(side, halfWid);
    out[0] = v3add(a, s);
    out[1] = v3add(a, v3scale(s, -1));
    out[2] = v3add(v3scale(a, -1), v3scale(s, -1));
    out[3] = v3add(v3scale(a, -1), s);
}

// One day's sun path, sampled every `stepMin` minutes, as unit sky directions.
// Only points above the horizon are returned (that is the visible arc). Uses the
// REAL firmware solar math, so these arcs are ground truth, not a re-derivation.
inline std::vector<V3> sunPathArc(int year, int month, int day,
                                  float lat, float lon, int stepMin = 10) {
    std::vector<V3> pts;
    for (int mins = 0; mins <= 24*60; mins += stepMin) {
        double h = mins / 60.0;
        SolarAngles s = calculateSolarPositionRaw(year, month, day, h, lat, lon);
        if (s.elevation > 0.0f) pts.push_back(skyDir(s.elevation, s.azimuth));
    }
    return pts;
}

// One sample of the panel's position over a day, for the angle/rate plots.
//   ideal   = the ideal single-axis tracking angle (unclamped)   [deg]
//   clamped = what the motor actually commands after ±limit clamp [deg]
//   rate    = d(ideal)/d(time), the instantaneous tracking speed  [deg/hr]
// A perfectly constant-speed panel would show rate == 15 deg/hr all day; the
// real value varies with latitude, season, and hour angle (it is only exactly
// 15 at the equator). Computed from the REAL firmware solar math.
struct DaySample { float hourUTC; float ideal; float clamped; float rate; bool up; };

inline std::vector<DaySample> panelDayCurve(int year, int month, int day,
                                            float lat, float lon,
                                            float axisTilt = 0, float axisAz = 0,
                                            float pmin = -30, float pmax = 30,
                                            int stepMin = 6) {
    std::vector<DaySample> v;
    float  prevIdeal = NAN; double prevH = NAN;
    for (int m = 0; m <= 24*60; m += stepMin) {
        double h = m / 60.0;
        SolarAngles s = calculateSolarPositionRaw(year, month, day, h, lat, lon, axisTilt, axisAz);
        DaySample d{}; d.hourUTC = (float)h; d.up = s.elevation > 0.0f;
        if (!d.up) { v.push_back(d); prevIdeal = NAN; continue; }
        float ideal = (float)panelAngleForAxis(s.elevation, s.azimuth, axisTilt, axisAz);
        d.ideal   = ideal;
        d.clamped = std::fmax(pmin, std::fmin(pmax, ideal));
        d.rate    = std::isnan(prevIdeal) ? NAN : (float)((ideal - prevIdeal) / (h - prevH));
        v.push_back(d);
        prevIdeal = ideal; prevH = h;
    }
    return v;
}

// Solar-noon summary for a date, and the ideal fixed tilt to set the panel to.
//   elev = the sun's highest elevation that day (its elevation at solar noon)
//   az   = the sun's azimuth at that moment (~180 = due south, ~0 = due north)
//   tilt = 90 - elev = the panel tilt (from horizontal) that points a panel
//          straight at the noon sun. This equals |latitude - declination|, so it
//          changes with the season (shallow in summer, steep in winter). The
//          panel should face the direction the noon sun is in (toward the equator).
struct NoonInfo { float elev; float az; float tilt; bool valid; };

inline NoonInfo solarNoon(int year, int month, int day, float lat, float lon) {
    NoonInfo n{0,0,0,false};
    float best = -90.0f;
    for (int m = 0; m <= 24*60; m += 2) {                 // scan the day for the peak
        SolarAngles s = calculateSolarPositionRaw(year, month, day, m/60.0, lat, lon);
        if (s.elevation > best) { best = s.elevation; n.elev = s.elevation; n.az = s.azimuth; }
    }
    n.valid = best > 0.0f;
    n.tilt  = 90.0f - n.elev;
    return n;
}

// A known-position checkpoint the professor can verify by eye (equator cases).
struct SunCheck {
    const char* label;   // e.g. "Equinox noon"
    float expElev;       // expected elevation (deg)
    float expAz;         // expected azimuth  (deg from N, cw); -1 = don't care (zenith)
};

// Reference sun positions at the EQUATOR (lat 0, lon 0) - the textbook cases in
// sun_paths.jpg. At lon 0, UTC == solar time, so noon is 12:00 UTC.
//   Equinox noon:      sun at the zenith         (elev 90°)
//   June solstice noon: 23.5° north of zenith    (elev 66.5°, azimuth   0° = N)
//   Dec  solstice noon: 23.5° south of zenith    (elev 66.5°, azimuth 180° = S)
//   Any equinox:        rises due E (az 90) 06:00, sets due W (az 270) 18:00
inline std::vector<SunCheck> equatorChecks() {
    return {
        { "Equinox noon (zenith)", 90.0f, -1.0f },
        { "Jun solstice noon (N)", 66.5f,   0.0f },
        { "Dec solstice noon (S)", 66.5f, 180.0f },
        { "Equinox sunrise (E)",    0.0f,  90.0f },
        { "Equinox sunset (W)",     0.0f, 270.0f },
    };
}
